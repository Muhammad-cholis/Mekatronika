#include <ThingSpeak.h>

unsigned long ChannelNumber = 1980820;
const char * myCounterReadAPIKey = "GLBIT0M9ZVO73BFS";
const char *writeAPI = "IB9LSPTDJ1TYC3CF";

// Deklarasi Blynk
#define BLYNK_TEMPLATE_ID "TMPLft0CmVLg"
#define BLYNK_DEVICE_NAME "Challage sistem monitoring suhu dan kelembaban"
#define BLYNK_AUTH_TOKEN "M-cU4pvxF6PLnOdkcjEqErYWYHDbrRki"

#include <ESP8266WiFi.h>
#define BLYNK_PRINT Serial
#include <BlynkSimpleEsp8266.h>
#include <SimpleTimer.h>
WiFiClient  client;

String thingSpeakAddress = "api.thingspeak.com";
String writeAPIKey;
String tsfield1Name;
String request_string;

// Timer variables
unsigned long lastTime = 0;
unsigned long timerDelay = 30000;

SimpleTimer timer;

char auth[] = "M-cU4pvxF6PLnOdkcjEqErYWYHDbrRki"; // masukkan kode autentikasi disini
char ssid[] = "Hilman Wifi"; //nama wifi
char pass[] = "12345abcde"; //password

// ESP8266 connection to L298N Fan Test
int enA = D4; // PWM for Motor A
int in1 = D5;  // Control Rotation of Motor A

//ESP8266 BTS7960 Heater Test
int RPWM = D7;
int LPWM = D8;
// timer 0
int EN = D6;

#include <Wire.h>
#include <Adafruit_GFX.h>
#include <Adafruit_SSD1306.h>
#include "DHT.h"


#define SCREEN_WIDTH 128 // OLED display width, in pixels
#define SCREEN_HEIGHT 64 // OLED display height, in pixels

#define OLED_RESET -1
#define SCREEN_ADDRESS 0x3C ///< See datasheet for Address; 0x3D for 128x64, 0x3C for 128x32
Adafruit_SSD1306 display(SCREEN_WIDTH, SCREEN_HEIGHT, &Wire, OLED_RESET);

// 'Blog_Parrot-Neonate-Care_Temp', 128x64px
const unsigned char myBitmap [] PROGMEM = {
  0x00, 0x01, 0x80, 0x00, 0x00, 0x00, 0x00, 0x00, 0x00, 0x00, 0x00, 0x00, 0x00, 0x00, 0x00, 0x00,
  0x00, 0x07, 0xe0, 0x00, 0x00, 0x00, 0x00, 0x00, 0x00, 0x00, 0x00, 0x00, 0x00, 0x00, 0x00, 0x00,
  0x00, 0x0c, 0x20, 0x00, 0x00, 0x00, 0x00, 0x00, 0x00, 0x00, 0x00, 0x00, 0x00, 0x00, 0x00, 0x00,
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  0x00, 0x00, 0x00, 0x00, 0x1f, 0x80, 0x00, 0x00, 0x00, 0x00, 0x00, 0x00, 0x00, 0x00, 0x00, 0x00
};

//#include "DHT.h"

#define DHTPIN D3
#define DHTTYPE DHT22
DHT dht(DHTPIN, DHTTYPE);

float Kp = 1;
float Ki = 0.1;
float Kd = 0.5;
float Error, dError, sum_Error;
float sp = 25;

void setup() {
  // put your setup code here, to run once:
  Serial.begin(115200);
  pinMode(enA, OUTPUT);
  pinMode(in1, OUTPUT);
  pinMode(RPWM, OUTPUT);
  pinMode(LPWM, OUTPUT);
  pinMode(EN, OUTPUT);

  digitalWrite(RPWM, LOW);
  digitalWrite(LPWM, LOW);
  digitalWrite(EN, LOW);

  dht.begin();
  //Memastikan OLED dapat berjalan atau tidak
  if (!display.begin(SSD1306_SWITCHCAPVCC, SCREEN_ADDRESS))
  {
    Serial.println(F("SSD1306 allocation failed"));
    for (;;); // Don't proceed, loop forever
  }
  display.clearDisplay();
  display.setTextSize(2);
  display.setTextColor(WHITE);
  display.setCursor(35, 0);
  display.print("MCSR");
  display.setTextSize(2);
  display.setCursor(20, 20);
  display.setTextColor(WHITE);
  display.println("Kelompok");
  display.setTextSize(2);
  display.setCursor(20, 40);
  display.setTextColor(WHITE);
  display.print("Blynk B"); //menampilkan karakter "Innovate Every Day" pada OLED
  display.display();

  Blynk.begin(auth, ssid, pass);
  WiFi.disconnect();
  WiFi.begin(ssid, pass);
  internet();

  Serial.println("");
  Serial.println("WiFi connected");
  Serial.println("IP address: ");
  Serial.println(WiFi.localIP());
  timer.setInterval (2000, pid);
  delay(2000);
}



void loop() {
  // put your main code here, to run repeatedly:
  kondisiOutput ();
  Blynk.run();
  timer.run();
}

void kondisiOutput () {
  int A = ThingSpeak.readLongField(ChannelNumber , 4, myCounterReadAPIKey);
  int B = ThingSpeak.readLongField(ChannelNumber , 5, myCounterReadAPIKey);
  float t = dht.readTemperature();
  oled(t);
  if (A == 1) {
    digitalWrite( in1 , HIGH);
    analogWrite(enA, 255); 
  }

  if (A == 0) {
    digitalWrite( in1 , HIGH);
    analogWrite(enA, 0);
  }

  if (B == 1) {
    analogWrite(RPWM, 255);
    analogWrite(LPWM, 0);
    digitalWrite(EN, HIGH);
  }

  if (B == 0) {
    analogWrite(RPWM, 0);
    analogWrite(LPWM, 0);
    digitalWrite(EN, HIGH);
  }

  if ( B == 0 && A == 0) {
    pid ();
  }
}

void kirim_thingspeak(float Suhu, float Fan, float Heater) {
  if (client.connect("api.thingspeak.com", 80)) {
    request_string = "/update?";
    request_string += "key=";
    request_string += "IB9LSPTDJ1TYC3CF";
    request_string += "&";
    request_string += "field1";
    request_string += "=";
    request_string += Suhu;
    request_string += "&";
    request_string += "field2";
    request_string += "=";
    request_string += Fan;
    request_string += "&";
    request_string += "field3";
    request_string += "=";
    request_string += Heater;


    Serial.println(String("GET ") + request_string + " HTTP/1.1\r\n" +
                   "Host: " + thingSpeakAddress + "\r\n" +
                   "Connection: close\r\n\r\n");

    client.print(String("GET ") + request_string + " HTTP/1.1\r\n" +
                 "Host: " + thingSpeakAddress + "\r\n" +
                 "Connection: close\r\n\r\n");
    unsigned long timeout = millis();
    while (client.available() == 0) {
      if (millis() - timeout > 5000) {
        Serial.println(">>> Client Timeout !");
        client.stop();
        return;
      }
    }

    while (client.available()) {
      String line = client.readStringUntil('\r');
      Serial.print(line);
    }

    Serial.println();
    Serial.println("closing connection");

  }
}

void internet()
{
  if (WiFi.status() != WL_CONNECTED)
  {
    while (WiFi.status() != WL_CONNECTED)
    {
      WiFi.begin(ssid, pass);
      delay(5000);
    }
  }
}

void pid ()
{
  int heater, fan;
  float t  = dht.readTemperature();
  sp = ThingSpeak.readLongField(ChannelNumber , 8, myCounterReadAPIKey);

  dError = Error;
  Error = t - sp;
  sum_Error += Error;

  float P = Kp * Error;
  float I = Ki * sum_Error;
  float D = (Kd / 100) * (Error - dError);

  float power = P + I + D;

  if (sp > t) {
    heater = map(Error, -10, 0, 255, 50);
    fan = 0;
  }
  else if (sp < t) {
    heater = 0;
    fan = map (Error, 0, 10, 50, 255);
  }
  digitalWrite( in1 , HIGH);
  analogWrite(enA, fan);

  analogWrite(RPWM, heater);
  analogWrite(LPWM, 0);
  digitalWrite(EN, HIGH);

  int speedFan = map(fan, 50, 255, 0, 100);
  int speedHeater = map(heater, 50, 255, 0, 100);

  kirim_thingspeak(t, speedFan, speedHeater);

  Blynk.virtualWrite(V0, t);
  Blynk.virtualWrite(V10, speedFan);
  Blynk.virtualWrite(V9, speedHeater);

  Serial.println (dError);
  Serial.print("  ");
  Serial.print (Error);
  Serial.print("  ");
  Serial.print (sum_Error);
  Serial.print("  ");
  Serial.print (sp);
  Serial.print("  ");
  Serial.print (t);
  Serial.print("  ");
  Serial.print (power);
  Serial.print("  ");
  Serial.print (fan);
  Serial.print("  ");
  Serial.print (heater);
  Serial.print("  ");
  oled(t);
}
void oled (float t) {
  display.clearDisplay();
  // display temperature
  display.setTextSize(1);
  display.setCursor(60, 0);
  display.print("Temperature ");
  display.setTextSize(2);
  display.setCursor(60, 10);
  display.print(t);
  display.drawBitmap(0, 0, myBitmap, 128, 32, WHITE);
  display.display();
  delay(5000);
}
